#include "zmk-nodefree-config-main/keypos_def/keypos_36keys.h"

#undef COMBO_HOOK
#define COMBO_HOOK global-quick-tap-ms = <100>;

#define COMBO_TERM_ExtraFAST 15
#define COMBO_TERM_FAST 20
#define COMBO_TERM_SLOW 90
#define COMBO_TERM_ExtraSLOW 120

ZMK_COMBO(percent,           &kp PERCENT,         LT4 LT3,     ALL, COMBO_TERM_FAST)
ZMK_COMBO(caret,             &kp CARET,           LM4 LM3,     ALL, COMBO_TERM_FAST)
ZMK_COMBO(exclamation,       &kp EXCLAMATION,     LB4 LB3,     ALL, COMBO_TERM_FAST)
ZMK_COMBO(backslash,         &kp BACKSLASH,       LT3 LT2,     ALL, COMBO_TERM_FAST)
ZMK_COMBO(dollar,            &kp DOLLAR,          LM3 LM2,     ALL, COMBO_TERM_FAST)
ZMK_COMBO(at_the_rate,       &kp AT,              LB3 LB2,     ALL, COMBO_TERM_FAST)
ZMK_COMBO(bracket_square_l,  &kp LBKT,            LT2 LT1,     ALL, COMBO_TERM_FAST)
ZMK_COMBO(bracket_round_l,   &kp LPAR,            LM2 LM1,     ALL, COMBO_TERM_ExtraFAST)
ZMK_COMBO(bracket_curly_l,   &kp LBRC,            LB2 LB1,     ALL, COMBO_TERM_FAST)
ZMK_COMBO(bracket_square_r,  &kp RBKT,            RT2 RT1,     ALL, COMBO_TERM_FAST)
ZMK_COMBO(bracket_round_r,   &kp RPAR,            RM1 RM2,     ALL, COMBO_TERM_ExtraFAST)
ZMK_COMBO(bracket_curly_r,   &kp RBRC,            RB1 RB2,     ALL, COMBO_TERM_FAST)
ZMK_COMBO(equal,             &kp EQUAL,           RT3 RT2,     ALL, COMBO_TERM_FAST)
ZMK_COMBO(semicolon,         &kp SEMICOLON,       RM3 RM2,     ALL, COMBO_TERM_FAST)
ZMK_COMBO(slash,             &kp SLASH,           RB3 RB2,     ALL, COMBO_TERM_FAST)
ZMK_COMBO(plus,              &kp PLUS,            RT4 RT3,     ALL, COMBO_TERM_FAST)
ZMK_COMBO(colon,             &kp COLON,           RM4 RM3,     ALL, COMBO_TERM_FAST)
ZMK_COMBO(question,          &kp QUESTION,        RB4 RB3,     ALL, COMBO_TERM_FAST)
ZMK_COMBO(grave,             &kp GRAVE,           LT3 LM3,     ALL, COMBO_TERM_SLOW)
ZMK_COMBO(ampersand,         &kp AMPERSAND,       LT2 LM2,     ALL, COMBO_TERM_SLOW)
ZMK_COMBO(asterisk,          &kp ASTERISK,        LT1 LM1,     ALL, COMBO_TERM_SLOW)
ZMK_COMBO(tilde,             &kp TILDE,           LM3 LB3,     ALL, COMBO_TERM_SLOW)
ZMK_COMBO(pipe,              &kp PIPE,            LM2 LB2,     ALL, COMBO_TERM_SLOW)
ZMK_COMBO(hash,              &kp HASH,            LM1 LB1,     ALL, COMBO_TERM_SLOW)
ZMK_COMBO(under,             &kp UNDER,           RT1 RM1,     ALL, COMBO_TERM_SLOW)
ZMK_COMBO(double_quotes,     &kp DOUBLE_QUOTES,   RT2 RM2,     ALL, COMBO_TERM_SLOW)
ZMK_COMBO(apostrophe,        &kp APOSTROPHE,      RT3 RM3,     ALL, COMBO_TERM_SLOW)
ZMK_COMBO(minus,             &kp MINUS,           RM2 RB2,     ALL, COMBO_TERM_SLOW)
ZMK_COMBO(enter,             &kp ENTER,           RM1 RB1,     ALL, COMBO_TERM_ExtraSLOW)
ZMK_COMBO(delete,            &kp DELETE,          RM3 RB3,     ALL, COMBO_TERM_ExtraSLOW)
ZMK_COMBO(tab,               &kp TAB,             RM0 RB0,     ALL, COMBO_TERM_ExtraSLOW)
ZMK_COMBO(escape,            &kp ESCAPE,          LM0 LB0,     ALL, COMBO_TERM_ExtraSLOW)
