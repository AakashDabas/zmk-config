#include <dt-bindings/zmk/matrix_transform.h>

/ {
    chosen {
        zmk,kscan = &kscan0;
        zmk,matrix_transform = &default_transform;
    };

    default_transform: keymap_transform_0 {
		compatible = "zmk,matrix-transform";
		columns = <2>;
		rows = <1>;
		map = <
RC(0,0) RC(0,1)
		>;
	};

    kscan0: kscan_0 {
        compatible = "zmk,kscan-gpio-matrix";
        label = "KSCAN";
        diode-direction = "col2row";

        col-gpios
            = <&pro_micro 20 GPIO_ACTIVE_HIGH>
            ;

        row-gpios
            = <&pro_micro 4 (GPIO_ACTIVE_HIGH | GPIO_PULL_DOWN)>
            ;
    };
};