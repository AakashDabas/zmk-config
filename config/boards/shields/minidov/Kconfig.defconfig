## config/boards/shields/minidov/Kconfig.defconfig
```kconfig
if SHIELD_MINIDOV_LEFT

config ZMK_KEYBOARD_NAME
    default "MINIDOV"

config ZMK_SPLIT_ROLE_CENTRAL
    default y

endif

if SHIELD_MINIDOV_RIGHT

config ZMK_KEYBOARD_NAME
    default "MINIDOV_R"

config ZMK_SPLIT_ROLE_CENTRAL
    default n

endif

if SHIELD_MINIDOV_LEFT || SHIELD_MINIDOV_RIGHT

config ZMK_SPLIT
    default y

endif
```

## config/boards/shields/minidov/Kconfig.shield
```kconfig
config SHIELD_MINIDOV_LEFT
    def_bool $(shields_list_contains,minidov_left)

    config SHIELD_MINIDOV_RIGHT
    def_bool $(shields_list_contains,minidov_right)
```

## config/west.yml
```yaml
manifest:
  remotes:
    - name: zmkfirmware
      url-base: https://github.com/zmkfirmwareq
  projects:
    - name: zmk
      remote: zmkfirmware
      revision: main
      import: app/west.yml
  self:
    path: config
```
