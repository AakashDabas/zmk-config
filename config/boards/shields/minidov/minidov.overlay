/ {
    chosen {
        zmk,kscan = &kscan0;
    };

    kscan0: kscan_0 {
        compatible = "zmk,kscan-gpio-matrix";
        label = "KSCAN";
        diode-direction = "col2row";

        col-gpios
            = <&pro_micro 15 GPIO_ACTIVE_HIGH>
            = <&pro_micro 13 GPIO_ACTIVE_HIGH>
            ;

        row-gpios
            = <&pro_micro 14 (GPIO_ACTIVE_HIGH | GPIO_PULL_DOWN)>
            ;
    };
};